#include <unity.h>
#include <Arduino.h>
#include <DeviceFramework.h>
#include <WiFiClient.h>
#include <DeviceFrameworkPlatform.h>  // Platform abstraction (includes HTTP client headers)
#include "../utils/test_utils.h"

// Include test configuration if available (generated by run-tests.sh)
#ifdef __has_include
    #if __has_include("test_config.h")
        #include "test_config.h"
    #endif
#endif

// Test web interface HTTP requests via endpoint fetcher
void test_web_interface_http_requests() {
    // Check if WiFi is connected - if not, skip the test
    if (!WiFi.isConnected()) {
        TEST_IGNORE_MESSAGE("WiFi not connected, skipping HTTP tests");
        return;
    }

    String fetcherURL = TEST_FETCHER_URL;
    String deviceIP = WiFi.localIP().toString();

    // Track memory statistics
    MemoryStats beforeTest = getMemoryStatsIfEnabled();

    // Initialize HTTP client manager for optimized testing
    if (!HTTPTestManager::initialize()) {
        TEST_FAIL_MESSAGE("Failed to initialize HTTP client manager");
        return;
    }

    // Test endpoint fetcher health endpoint
    if (!testHttpEndpoint(fetcherURL + "/health", 200, "", "fetcher health", 3000)) {
        TEST_IGNORE_MESSAGE("Endpoint fetcher not available - check if fetcher service is running");
        HTTPTestManager::cleanup();
        return;
    }

    MemoryStats afterHealth = getMemoryStatsIfEnabled();
    logDeltaIfEnabled(beforeTest, afterHealth, "After fetcher health test");

    // Test API status endpoint
    const String apiStatusExpected[] = {
        "runtime",
        "chip_id",
        "version"
    };
    auto apiStatusResult = CachedEndpointTester::testEndpoint(
        fetcherURL, deviceIP, "/api/status", 200, apiStatusExpected, 3);
    TEST_ASSERT_TRUE_MESSAGE(apiStatusResult.success, "API status endpoint test");

    // Test web interface root endpoint
    const String webRootExpected[] = {
        "<!DOCTYPE html>",
        "Device Status",
        "System Controls",
        "refreshStatus()"
    };
    auto webRootResult = CachedEndpointTester::testEndpoint(
        fetcherURL, deviceIP, "/", 200, webRootExpected, 4);
    TEST_ASSERT_TRUE_MESSAGE(webRootResult.success, "Web interface root test");

    // Test 404 endpoint
    const String error404Expected[] = {
        "404",
        "Page Not Found",
        "Return to Home"
    };
    auto error404Result = CachedEndpointTester::testEndpoint(
        fetcherURL, deviceIP, "/notfound", 200, error404Expected, 3);
    TEST_ASSERT_TRUE_MESSAGE(error404Result.success, "404 endpoint test");

    MemoryStats afterTests = getMemoryStatsIfEnabled();
    logDeltaIfEnabled(afterHealth, afterTests, "After all HTTP tests");

    // Print final performance statistics
    HTTPTestManager::printStats();

    // Cleanup HTTP client manager
    HTTPTestManager::cleanup();
}
