#include <unity.h>
#include <Arduino.h>
#include <DeviceFramework.h>
#include <Configuration/DeviceFrameworkConfig.h>
#include <WiFiClient.h>
#include <DeviceFrameworkPlatform.h>  // Platform abstraction (includes HTTP client headers)
#include <Storage/DeviceFrameworkStorage.h>
#include <ArduinoHA.h>
#include <Utils/HostnameUtils.h>
#include <Utils/CRC32Utils.h>
#include <Utils/TimeUtils.h>
#include "test_main.h"
#include "utils/test_utils.h"

// Include test configuration if available (generated by run-tests.sh)
#ifdef __has_include
    #if __has_include("test_config.h")
        #include "test_config.h"
    #endif
#endif

// Test case array - organized by state dependencies
// Group 1: Stateless Utilities (no dependencies)
// Group 2: Initial State Verification (after setup)
// Group 3: Configuration & Storage (independent, can modify state)
// Group 4: Network-Dependent (requires WiFi/MQTT)
// Group 5: ParameterRegistry Integration (modifies parameters)
// Group 6: Web Interface (requires web server)
TestCase tests[] = {
    // Group 1: Stateless Utilities
    TEST_ENTRY(test_hostname_utils),
    TEST_ENTRY(test_crc32_utils),
    TEST_ENTRY(test_time_utils),

    // Group 2: Initial State Verification
    TEST_ENTRY(test_device_framework_basic_methods),
    TEST_ENTRY(test_device_framework_setup_verification),

    // Run rendering while the production server is initialized but before
    // fault-injection storage tests deliberately churn the allocator.
    TEST_ENTRY(test_web_interface_methods),
    TEST_ENTRY(test_eeprom_storage_methods),
    TEST_ENTRY(test_storage_legacy_markers_allow_profile_cutover),

    // Group 3: Configuration & Storage
    TEST_ENTRY(test_device_framework_configuration),
    TEST_ENTRY(test_device_framework_ui_configuration),
    TEST_ENTRY(test_storage_save_load),
    TEST_ENTRY(test_storage_falls_back_to_prior_valid_slot),
    TEST_ENTRY(test_storage_foreign_application_is_distinguished),
    TEST_ENTRY(test_storage_incompatible_schema_retains_device_password),
    TEST_ENTRY(test_storage_station_profiles_round_trip),
    TEST_ENTRY(test_profile_password_is_persistent_without_reprovisioning),

    // Group 4: Network-Dependent
    TEST_ENTRY(test_wifi_manager_state),
    TEST_ENTRY(test_device_framework_mqtt_settings),
    TEST_ENTRY(test_mqtt_command_handlers),

    // Group 5: ParameterRegistry Integration
    TEST_ENTRY(test_parameter_registry_integration),
    TEST_ENTRY(test_parameter_registry_ha_origin_updates_shadow_state),
};

const size_t TEST_COUNT = sizeof(tests) / sizeof(TestCase);
bool resourceLimitsConfigured = false;

// Test state variables
size_t next_index = 0;
bool begun = false;
bool frameworkSetup = false;
bool wifiConnected = false;
bool mqttConnected = false;
unsigned long connectionWaitStartedAt = 0;
constexpr unsigned long CONNECTION_READY_TIMEOUT_MS = 120000UL;
constexpr unsigned long SERIAL_MONITOR_ATTACH_DELAY_MS = 5000UL;

// Dummy test device entities (simulating typical consuming sketch)
HASensorNumber testSensor("test_sensor", HASensorNumber::PrecisionP1);
HASwitch testSwitch("test_switch");

// Test setup and teardown
void setUp(void) {
    // No per-test setup needed - DeviceFramework is set up once in main setup()
#ifdef ENABLE_MEMORY_LOGGING
    if (next_index < TEST_COUNT) {
        Serial.print("\n[TEST] [MEMORY BEFORE] ");
        Serial.print(tests[next_index].name);
        Serial.print(" - ");
        logTestMemory(tests[next_index].name, "BEFORE");
    }
#endif
}

void tearDown(void) {
    // No per-test teardown needed
#ifdef ENABLE_MEMORY_LOGGING
    if (next_index > 0) {
        Serial.print("\n[TEST] [MEMORY AFTER] ");
        Serial.print(tests[next_index - 1].name);
        Serial.print(" - ");
        logTestMemory(tests[next_index - 1].name, "AFTER");
    }
#endif
}

#ifdef DF_PLATFORM_ESP32
#include <esp_system.h>
#include <soc/soc.h>
#include <soc/rtc_cntl_reg.h>
#include <rom/rtc.h>
#endif

// ESP32 Panic Handler - prints exception info
#ifdef DF_PLATFORM_ESP32
void printExceptionInfo() {
    delay(100);
    Serial.println("\n=== EXCEPTION OCCURRED ===");
    Serial.print("Reset reason: ");
    esp_reset_reason_t reason = esp_reset_reason();
    switch(reason) {
        case ESP_RST_POWERON: Serial.println("Power-on reset"); break;
        case ESP_RST_EXT: Serial.println("External reset"); break;
        case ESP_RST_SW: Serial.println("Software reset"); break;
        case ESP_RST_PANIC: Serial.println("Exception/panic"); break;
        case ESP_RST_INT_WDT: Serial.println("Interrupt watchdog reset"); break;
        case ESP_RST_TASK_WDT: Serial.println("Task watchdog reset"); break;
        case ESP_RST_WDT: Serial.println("Other watchdog reset"); break;
        case ESP_RST_DEEPSLEEP: Serial.println("Deep sleep reset"); break;
        case ESP_RST_BROWNOUT: Serial.println("Brownout reset"); break;
        case ESP_RST_SDIO: Serial.println("SDIO reset"); break;
        default: Serial.println("Unknown"); break;
    }
    Serial.println("==========================\n");
}
#endif

// Arduino setup and loop functions (required by framework)
void setup() {
    #ifdef DF_PLATFORM_ESP32
        // Disable brownout detector to prevent resets during flash operations
        WRITE_PERI_REG(RTC_CNTL_BROWN_OUT_REG, 0);
        // Print exception info if this was a crash restart
        if (esp_reset_reason() == ESP_RST_PANIC || esp_reset_reason() == ESP_RST_TASK_WDT) {
            Serial.begin(115200);
            delay(100);
            printExceptionInfo();
        }
    #endif

    Serial.begin(115200);
    // The uploader hard-resets the board before PlatformIO opens its test reader.
    // Leave a test-only grace window so the reader sees the complete Unity output.
    delay(SERIAL_MONITOR_ATTACH_DELAY_MS);
    markSerialAsInitialized(); // Tell framework Serial is already initialized

    Serial.println("\n[TEST] =============================================");
    Serial.println("[TEST] === DeviceFramework Test Setup ===");
    Serial.println("[TEST] Starting DeviceFramework tests...");
    Serial.println("[TEST] =============================================");

    // Clear EEPROM to start with a clean state for testing
    Serial.println("[TEST]   Clearing EEPROM for clean test state...");
    uint16_t eepromSize = getConfigEEPROMSize();
    EEPROM.begin(eepromSize);
    for (size_t i = 0; i < eepromSize; i++) {
        EEPROM.write(i, 0xFF);
        if ((i & 0x7fU) == 0) {
            yield();
        }
    }
    yield();
    EEPROM.commit();
    yield();
    #ifdef DF_PLATFORM_ESP8266
        EEPROM.end();
    #endif
    #ifdef DF_PLATFORM_ESP32
        delay(100);
    #endif
    Serial.println("[TEST]   EEPROM cleared");
    Serial.println("[TEST]     Configuring shared UI...");

    // Simulate a real sketch setup and register custom parameters.
    Serial.println("[TEST]   Configuring test parameters...");

    Serial.println("[TEST]     Calling DeviceFramework::beforeSetup()...");
    DeviceFrameworkUIConfig ui;
    ui.branding.brandName = DeviceFrameworkText::ram("Test Lab");
    ui.branding.productName = DeviceFrameworkText::ram("DeviceFramework UI Test");
    ui.branding.provisioningTitle = DeviceFrameworkText::ram("Set up DeviceFramework UI Test");
    ui.branding.provisioningTagline = DeviceFrameworkText::ram("Connected-device portal and web UI verification.");
    ui.branding.logoAltText = DeviceFrameworkText::ram("Test Lab");
    ui.about.summary = DeviceFrameworkText::ram("Test firmware validates the fixed product About area.");
    ui.about.primaryLink = {DeviceFrameworkText::ram("Test Lab"),
                            DeviceFrameworkText::ram("https://example.test")};
    ui.about.creditLink = {DeviceFrameworkText::ram("Credits"),
                           DeviceFrameworkText::ram("https://example.test/credits")};
    ui.theme.pageStart = DeviceFrameworkText::ram("#14532d");
    ui.theme.pageEnd = DeviceFrameworkText::ram("#166534");
    ui.theme.surface = DeviceFrameworkText::ram("#f0fdf4");
    ui.theme.text = DeviceFrameworkText::ram("#052e16");
    ui.theme.mutedText = DeviceFrameworkText::ram("#166534");
    ui.theme.border = DeviceFrameworkText::ram("#bbf7d0");
    ui.theme.accent = DeviceFrameworkText::ram("#15803d");
    ui.theme.accentHover = DeviceFrameworkText::ram("#166534");
    ui.theme.accentText = DeviceFrameworkText::ram("#ffffff");
    ui.theme.success = DeviceFrameworkText::ram("#16a34a");
    ui.theme.danger = DeviceFrameworkText::ram("#dc2626");
    DeviceFramework::setUIConfig(ui);
    Serial.println("[TEST]     Shared UI configured");

    // A consuming sketch configures web policy before framework setup. Give
    // this test firmware room for two ordinary concurrent status responses.
    DeviceFrameworkWebResourceLimits webResourceLimits =
        DeviceFrameworkWeb::defaultResourceLimits();
    webResourceLimits.maxConcurrentStreamResponses = 2;
    resourceLimitsConfigured = DeviceFrameworkWeb::setResourceLimits(webResourceLimits);

    Serial.println("[TEST]     Registering parameters...");

    DeviceFramework::beforeSetup([]() {
        auto& paramRegistry = DeviceFrameworkParameters::getRegistry();
        DeviceFrameworkParameterMetadata testParamMeta;
        testParamMeta.id = "testdevicename";
        testParamMeta.label = "Test Device Name";
        testParamMeta.sources = SOURCE_WIFI_MANAGER;
        testParamMeta.defaultValue = "test-device";
        testParamMeta.maxLength = 20;
        testParamMeta.order = 5;  // After core parameters (0-4)
        paramRegistry.registerParameter(testParamMeta);
        Serial.println("[TEST]     Custom parameter registered: testdevicename");

        DeviceFrameworkParameterMetadata haSwitchMeta;
        haSwitchMeta.id = "testhaswitch";
        haSwitchMeta.label = "Test HA Switch";
        haSwitchMeta.sources = SOURCE_HOME_ASSISTANT;
        haSwitchMeta.defaultValue = "false";
        haSwitchMeta.maxLength = 5;
        haSwitchMeta.order = 6;
        haSwitchMeta.haDeviceType = HAConfigDeviceType::SWITCH;
        paramRegistry.registerParameter(haSwitchMeta);
        Serial.println("[TEST]     Custom HA parameter registered: testhaswitch");
    });

    // DeviceFramework 2.2 owns station connection through the profile controller.
    // Seed its candidate instead of relying on the ESP SDK's legacy credential slot.
    Serial.println("[TEST]   Preloading WiFi profile candidate...");
    DeviceFrameworkWiFi::preloadWiFi(TEST_WIFI_SSID, TEST_WIFI_PASSWORD);

    // Setup DeviceFramework (now with proper sketch-like configuration)
    Serial.println("[TEST]   Setting up DeviceFramework...");
    DeviceFramework::setup();
    frameworkSetup = true;
    Serial.println("[TEST]   DeviceFramework setup completed");

    // Set test parameters after DeviceFramework setup (to override any defaults loaded from EEPROM)
    Serial.println("[TEST]   Setting test parameters...");

    Serial.print("[TEST]     Setting device name: ");
    Serial.println(DF_DEFAULT_DEVICE_NAME);
    DeviceFramework::setDeviceName(DF_DEFAULT_DEVICE_NAME);

    Serial.print("[TEST]     Setting MQTT server: ");
    Serial.println(TEST_MQTT_SERVER);
    DeviceFramework::setMqttServer(TEST_MQTT_SERVER);

    Serial.print("[TEST]     Setting MQTT port: ");
    Serial.println(1883);
    DeviceFramework::setMqttPort(1883);

    Serial.print("[TEST]     Setting MQTT user: ");
    Serial.println(TEST_MQTT_USER);
    DeviceFramework::setMqttUser(TEST_MQTT_USER);

    Serial.print("[TEST]     Setting MQTT password: ");
    Serial.println("[HIDDEN]");
    DeviceFramework::setMqttPass(TEST_MQTT_PASSWORD);

    // Register harmless command handlers for live MQTT coverage.

    // Add custom MQTT command handlers for testing
    DeviceFramework::registerSharedCommandHandler("test_command", [](const uint8_t* payload, const uint16_t length) {
        Serial.println("Test shared command received!");
    });

    DeviceFramework::registerDeviceCommandHandler(&testSensor, "test_command", [](const uint8_t* payload, const uint16_t length) {
        Serial.println("Test device command received!");
    });

    // Configure dummy test entities (simulating typical consuming sketch)
    testSensor.setName("Test Sensor");
    testSensor.setUnitOfMeasurement("units");
    testSensor.setIcon("mdi:gauge");

    testSwitch.setName("Test Switch");
    testSwitch.setIcon("mdi:toggle-switch");

    Serial.println("[TEST]   Test framework configured with automatic ArduinoHA entity registration");

    UNITY_BEGIN(); // Start Unity test framework
    begun = true; // Start tests immediately
    connectionWaitStartedAt = millis();
}

void loop() {
    // Run DeviceFramework loop to handle WiFi and MQTT connections non-blocking
    if (frameworkSetup) {
        DeviceFramework::loop();
    }

    // Check WiFi and MQTT connection status and wait before starting tests
    if (begun && (!wifiConnected || !mqttConnected)) {
        bool wifiConnectedNow = WiFi.isConnected();
        bool mqttConnectedNow = DeviceFrameworkMQTT::isConnected();
        bool inConfigMode = DeviceFramework::isInConfigMode();

        // Update WiFi connection status
        if (wifiConnectedNow && !wifiConnected) {
            wifiConnected = true;
            Serial.println("\n[TEST] --- WiFi Connected ---");
            Serial.print("[TEST] IP: ");
            Serial.println(WiFi.localIP());
            Serial.print("[TEST] SSID: ");
            Serial.println(WiFi.SSID());
        }

        // Update MQTT connection status
        if (mqttConnectedNow && !mqttConnected) {
            mqttConnected = true;
            Serial.println("[TEST] --- MQTT Connected ---");
        }

        // Check if we're ready to start tests
        if (wifiConnected && mqttConnected) {
            Serial.println("[TEST] --- All connections ready - Starting tests ---\n");
        } else if (inConfigMode && wifiConnected) {
            // WiFi connected but MQTT failed, but config mode is active - start tests anyway
            mqttConnected = true; // Mark as "ready" to start tests
            Serial.println("[TEST] --- Config mode active - Starting tests ---\n");
        } else {
            if (millis() - connectionWaitStartedAt >= CONNECTION_READY_TIMEOUT_MS) {
                Serial.println("[TEST] Connection readiness timeout; ending suite");
                UNITY_END();
                begun = false;
                return;
            }
            // Print status every 5 seconds
            static unsigned long lastStatusPrint = 0;
            if (millis() - lastStatusPrint > 5000) {
                Serial.print("[TEST] Waiting for connections... WiFi: ");
                Serial.print(wifiConnectedNow ? "YES" : "NO");
                Serial.print(", MQTT: ");
                Serial.print(mqttConnectedNow ? "YES" : "NO");
                Serial.print(", Config mode: ");
                Serial.println(inConfigMode ? "YES" : "NO");
                lastStatusPrint = millis();
            }
            return; // Don't start tests yet
        }
    }

    // Run one test and return immediately
    if (begun && wifiConnected && mqttConnected && next_index < TEST_COUNT) {
        TestCase& t = tests[next_index];
        Serial.print("\n[TEST] ==== Running test: ");
        Serial.print(t.name);
        Serial.println(" ====");
        UnityDefaultTestRun(t.fn, t.name, t.line);
        next_index++;
        return; // yield quickly
    }

    // All tests completed
    if (begun && wifiConnected && mqttConnected && next_index >= TEST_COUNT) {
        Serial.println("\n[TEST] =============================================");
        Serial.println("[TEST] === All tests completed ===");
        Serial.println("[TEST] =============================================");
        UNITY_END(); // prints Unity summary
        begun = false; // avoid repeating
    }
}
